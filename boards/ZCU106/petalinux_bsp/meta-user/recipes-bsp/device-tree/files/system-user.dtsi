/include/ "system-conf.dtsi"
/ {
        chosen {
	        xlnx,eeprom = &eeprom;
        };

	reserved-memory {
		#address-cells = <2>;
		#size-cells = <2>;
		ranges;
		linux,cma {
			compatible = "shared-dma-pool";
			reusable;
			size=<0x0 0x20000000>;
			alloc-ranges = <0x0 0x0 0x0 0x7ff00000>;
			alignment = <0x0 0x2000>;
			linux,cma-default;
		};
	};
};

